## conf/layer.conf
```bitbake
# We have a conf and classes directory, add to BBPATH
BBPATH .= ":${LAYERDIR}"

# We have recipes-* directories, add to BBFILES
BBFILES += "${LAYERDIR}/recipes-*/*/*.bb \
            ${LAYERDIR}/recipes-*/*/*.bbappend"

BBFILE_COLLECTIONS += "meta-aws-iot-rpi-distro"
BBFILE_PATTERN_meta-aws-iot-rpi-distro = "^${LAYERDIR}/"
BBFILE_PRIORITY_meta-aws-iot-rpi-distro = "9"

LAYERDEPENDS_meta-aws-iot-rpi-distro = "core"
LAYERSERIES_COMPAT_meta-aws-iot-rpi-distro = "kirkstone"
```

## conf/local.conf
```bitbake
DISTRO ?= "poky"

PACKAGE_CLASSES ?= "package_rpm"

EXTRA_IMAGE_FEATURES ?= "debug-tweaks"

USER_CLASSES ?= "buildstats"

BB_DISKMON_DIRS ??= "\
    STOPTASKS,${TMPDIR},1G,100K \
    STOPTASKS,${DL_DIR},1G,100K \
    STOPTASKS,${SSTATE_DIR},1G,100K \
    STOPTASKS,/tmp,100M,100K \
    HALT,${TMPDIR},100M,1K \
    HALT,${DL_DIR},100M,1K \
    HALT,${SSTATE_DIR},100M,1K \
    HALT,/tmp,10M,1K"

CONF_VERSION = "2"

PATCHRESOLVE = "noop"
QB_MEM = "-m 4096"

DISTRO_FEATURES:append = " largefile ptest multiarch systemd"
VIRTUAL-RUNTIME_init_manager = "systemd"
VIRTUAL-RUNTIME_initscripts = ""
VIRTUAL-RUNTIME_syslog = ""
VIRTUAL-RUNTIME_nested = "false"

VIRTUAL-RUNTIME_login_manager = "shadow-base"
HOSTTOOLS_NONFATAL:append = " ssh"

PACKAGECONFIG:append:pn-qemu-system-native = " sdl"

DISTRO_FEATURES:remove = " x11 opengl dri3 vulkan"

MACHINE_FEATURES:remove = "xserver vc4graphics mesa mesa-gl "
DISABLE_VC4GRAPHICS = "1"

RPI_USE_U_BOOT = "1"
ENABLE_SPI_BUS = "1"
ENABLE_UART = "1"

IMAGE_FSTYPES = "ext4.gz ext3 rpi-sdimg"
IMAGE_FSTYPES:append = " wic wic.bmap wic.bz2 "

DISTRO_FEATURES:append = " wifi"

WKS_FILE = "swu-raspberrypi.wks"

MACHINE = "raspberrypi4"

DEMO_IOT_ENDPOINT = "<ENDPOINT>"
DEMO_THING_NAME= "<thing name used for provisioning>"

UNICORN_RPI_SSID = "<WIFI SSID>"
UNICORN_RPI_PSK = "<PSK>"
DISABLE_VC4GRAPHICS = "1"
DISABLE_OVERSCAN = "1"


# Configuration for aws-iot-device-client
# All samples 
PACKAGECONFIG:remove:pn-aws-iot-device-client = " samples"
# Pubsub sample
PACKAGECONFIG:remove:pn-aws-iot-device-client = " pubsub"
# Device Defender
PACKAGECONFIG:remove:pn-aws-iot-device-client = " dd"
# Fleet management - provisioning
PACKAGECONFIG:append:pn-aws-iot-device-client = " fp"
# Fleet management - jobs
PACKAGECONFIG:append:pn-aws-iot-device-client = " jobs"
# Secure tunneling
PACKAGECONFIG:remove:pn-aws-iot-device-client = " st"
# Device shadow
PACKAGECONFIG:remove:pn-aws-iot-device-client = " ds"
# Device shadow - config shadow
PACKAGECONFIG:remove:pn-aws-iot-device-client = " dsc"
# Device shadow - named shadow
PACKAGECONFIG:remove:pn-aws-iot-device-client = " dsn"
```
